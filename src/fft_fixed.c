/*
 * fft_fixed.c — Iterative Cooley-Tukey radix-2 DIT FFT
 *
 * Fixed-point Q15 arithmetic.  No heap, no recursion, no CMSIS-DSP.
 *
 * Twiddle factors are stored as Q15 cos/sin pairs.
 * Pre-computed for N up to 512 at compile time.
 *
 * Reference: "Numerical Recipes in C", Chapter 12.2 (adapted for integer).
 */

#include <zephyr/kernel.h>
#include <zephyr/logging/log.h>
#include <stdint.h>
#include <string.h>

#include "fft_fixed.h"

LOG_MODULE_REGISTER(fft_fixed, LOG_LEVEL_WRN);  /* WRN: suppress debug in prod */

/* ──────────────────────────────────────────────
 * Q15 twiddle factor table
 *
 * We store cos(-2π k/N) for k = 0 .. N/2-1, N=512.
 * sin(-2π k/N) = cos(-2π k/N + π/2) = table[(k + N/4) % (N/2)]
 *
 * Values: int16_t in range [-32768, 32767]
 *   1.0  → 32767
 *  -1.0  → -32768
 *   cos(0)      = 32767
 *   cos(π/2)    = 0
 *   cos(π)      = -32768
 *
 * Generated by: round(32767 * cos(-2*pi*k/512)) for k=0..255
 *
 * Only need N/2 = 256 entries for N=512. For smaller FFTs we subsample.
 * ────────────────────────────────────────────── */

/* 256 cosine values for k=0..255, N=512 */
static const int16_t cos_table_512[256] = {
	 32767,  32757,  32728,  32678,  32609,  32520,  32412,  32284,
	 32137,  31970,  31785,  31580,  31356,  31113,  30851,  30571,
	 30272,  29955,  29621,  29268,  28898,  28510,  28105,  27683,
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	 32137,  32284,  32412,  32520,  32609,  32678,  32728,  32757,
};

/* sin(-2πk/512) = cos(-2πk/512 + π/2) = cos_table[(k+128) % 256] */
static inline int16_t twiddle_cos(uint16_t k, uint16_t N)
{
	/* Sub-sample the 512-point table for smaller N */
	uint32_t idx = ((uint32_t)k * 256) / (N / 2);
	return cos_table_512[idx & 255];
}

static inline int16_t twiddle_sin(uint16_t k, uint16_t N)
{
	/* sin(-θ) = -sin(θ), sin(-2πk/N) = cos(-2πk/N + π/2) */
	uint32_t idx = ((uint32_t)k * 256) / (N / 2);
	/* Shift by N/4 in the 256-entry space = shift by 64 */
	return cos_table_512[(idx + 64) & 255];
}

/* ──────────────────────────────────────────────
 * Bit-reversal permutation
 * ────────────────────────────────────────────── */
static uint16_t bit_reverse(uint16_t x, uint16_t log2n)
{
	uint16_t result = 0;
	for (uint16_t i = 0; i < log2n; i++) {
		result = (result << 1) | (x & 1);
		x >>= 1;
	}
	return result;
}

static void bit_reverse_reorder(int32_t *re, int32_t *im, uint16_t N)
{
	uint16_t log2n = 0;
	uint16_t tmp = N;
	while (tmp > 1) { log2n++; tmp >>= 1; }

	for (uint16_t i = 0; i < N; i++) {
		uint16_t j = bit_reverse(i, log2n);
		if (j > i) {
			int32_t tr = re[i]; re[i] = re[j]; re[j] = tr;
			int32_t ti = im[i]; im[i] = im[j]; im[j] = ti;
		}
	}
}

/* ──────────────────────────────────────────────
 * Iterative Cooley-Tukey DIT FFT
 *
 * Butterfly: [re_u, im_u]   ← [a + W·b]
 *            [re_v, im_v]   ← [a - W·b]
 *
 * W = cos(−2πk/L) + j·sin(−2πk/L)
 *
 * Q15 butterfly:
 *   tr = (re_v * wr - im_v * wi) >> 15
 *   ti = (re_v * wi + im_v * wr) >> 15
 *   re_v = re_u - tr;  re_u = re_u + tr
 *   im_v = im_u - ti;  im_u = im_u + ti
 *
 * We divide by 2 at each stage to prevent overflow (1/N total scaling).
 * ────────────────────────────────────────────── */
void fft_fixed(int32_t *re, int32_t *im, uint16_t N)
{
	bit_reverse_reorder(re, im, N);

	for (uint16_t L = 2; L <= N; L <<= 1) {
		uint16_t half = L >> 1;

		for (uint16_t k = 0; k < half; k++) {
			int32_t wr = twiddle_cos(k, L);   /* Q15 */
			int32_t wi = twiddle_sin(k, L);   /* Q15 */

			for (uint16_t m = k; m < N; m += L) {
				uint16_t u = m;
				uint16_t v = m + half;

				/* Twiddle: W × [re[v], im[v]] */
				int32_t tr = (re[v] * wr - im[v] * wi) >> 15;
				int32_t ti = (re[v] * wi + im[v] * wr) >> 15;

				/* Butterfly with scale-by-2 guard */
				re[v] = (re[u] - tr) >> 1;
				im[v] = (im[u] - ti) >> 1;
				re[u] = (re[u] + tr) >> 1;
				im[u] = (im[u] + ti) >> 1;
			}
		}
	}
}

/* ──────────────────────────────────────────────
 * Integer square root (Babylonian)
 * ────────────────────────────────────────────── */
uint32_t fft_isqrt32(uint32_t n)
{
	if (n == 0) return 0;
	uint32_t x = n;
	uint32_t y = (x + 1) >> 1;
	while (y < x) {
		x = y;
		y = (x + n / x) >> 1;
	}
	return x;
}
