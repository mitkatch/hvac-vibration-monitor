/*
 * thread.c — Thread network transport
 *
 * Responsibilities:
 *   1. Configure hardcoded dataset (channel / PAN / network key).
 *      The mesh-local prefix is hardcoded alongside all other credentials
 *      so that IPHC SAM=11 source reconstruction on the OTBR always matches
 *      the address used for the UDP checksum pseudo-header.
 *   2. Start the OpenThread stack (manual start).
 *   3. Watch role changes → post EVT_THREAD_CONNECTED / EVT_THREAD_DISCONNECTED
 *      to the FSM event queue.
 *   4. thread_publish_burst(): send one vibration burst as 3 small CoAP NON
 *      POST packets, each fitting in a single 802.15.4 frame:
 *
 *        PKT_TYPE_TIME_STATS   burst_header(10) + time_stats(36) → 61 B CoAP
 *        PKT_TYPE_FFT_STATS    burst_header(10) + fft_stats(60)  → 85 B CoAP
 *        PKT_TYPE_ENV          burst_header(10) + env(8)          → 33 B CoAP  (optional)
 *
 *      Single-frame capacity after MAC + AES-CCM overhead: ~106 bytes.
 *      All three packets carry the same seq and timestamp_ms so the backend
 *      can correlate them by (source_addr, seq).
 *
 * Credentials are hardcoded for v1.  They will be settable at runtime via
 * a CoAP command channel in a future release.
 */

#include <zephyr/kernel.h>
#include <zephyr/logging/log.h>
#include <zephyr/net/openthread.h>

#include <openthread/coap.h>
#include <openthread/instance.h>
#include <openthread/thread.h>
#include <openthread/dataset.h>
#include <openthread/ip6.h>

#include "thread.h"
#include "analysis.h"

LOG_MODULE_REGISTER(thread_net, LOG_LEVEL_INF);

/* ── Hardcoded network credentials (v1) ─────────────────────────── */
/* Generated by Pi border router — extract with: sudo ot-ctl dataset active */
#define THREAD_CHANNEL       23
#define THREAD_PANID         0xC442
#define THREAD_NETWORK_NAME  "OpenThread-c442"

/* 128-bit network key: 24e1e449d9baa91d981a292c158c8fbd */
static const uint8_t k_network_key[OT_NETWORK_KEY_SIZE] = {
	0x24, 0xe1, 0xe4, 0x49, 0xd9, 0xba, 0xa9, 0x1d,
	0x98, 0x1a, 0x29, 0x2c, 0x15, 0x8c, 0x8f, 0xbd
};

/* 64-bit extended PAN ID: e3d0d38fad236397 */
static const uint8_t k_ext_pan_id[OT_EXT_PAN_ID_SIZE] = {
	0xe3, 0xd0, 0xd3, 0x8f, 0xad, 0x23, 0x63, 0x97
};

/*
 * 64-bit mesh-local prefix: fd42:46fb:fcc2:f867::/64
 *
 * Must match the OTBR's active dataset exactly.  The OTBR reconstructs our
 * RLOC source address from IPHC SAM=11 + this prefix, so any mismatch between
 * the prefix used for the UDP checksum pseudo-header and the prefix used by
 * the OTBR for IPHC decompression produces "Bad UDP checksum".
 *
 * Read with: sudo docker exec <id> ot-ctl dataset active
 */
static const uint8_t k_mesh_local_prefix[OT_IP6_PREFIX_SIZE] = {
	0xfd, 0x42, 0x46, 0xfb, 0xfc, 0xc2, 0xf8, 0x67
};

/* ── CoAP target ─────────────────────────────────────────────────── */
#define COAP_PORT      5683
#define COAP_RESOURCE  "telemetry"

/* Largest payload passed to send_ot_coap: burst_header + fft_stats */
#define BODY_BUF_MAX   (sizeof(burst_header_t) + sizeof(fft_stats_t))

/* ── Module state ────────────────────────────────────────────────── */
static event_post_fn  s_evt_post;
static bool           s_connected;
static bool           s_coap_started;

static struct openthread_state_changed_callback s_state_cb;

/* ── Role-change callback (runs on OpenThread thread) ───────────── */
static void ot_state_changed(otChangedFlags flags, void *context)
{
	ARG_UNUSED(context);

	if (!(flags & OT_CHANGED_THREAD_ROLE)) {
		return;
	}

	otDeviceRole role = otThreadGetDeviceRole(openthread_get_default_instance());

	bool connected = (role != OT_DEVICE_ROLE_DETACHED &&
			  role != OT_DEVICE_ROLE_DISABLED);

	if (connected == s_connected) {
		return;
	}

	s_connected = connected;

	fsm_event_t evt = {
		.type      = connected ? EVT_THREAD_CONNECTED : EVT_THREAD_DISCONNECTED,
		.timestamp = k_uptime_get_32(),
	};

	LOG_INF("Thread role → %d (%s)", role, connected ? "connected" : "detached");

	if (s_evt_post) {
		s_evt_post(&evt);
	}
}

/* ── Dataset configuration ────────────────────────────────────────── */
static int configure_dataset(otInstance *instance)
{
	otOperationalDataset ds = { 0 };

	ds.mActiveTimestamp.mSeconds             = 1;
	ds.mComponents.mIsActiveTimestampPresent = true;

	ds.mChannel                              = THREAD_CHANNEL;
	ds.mComponents.mIsChannelPresent         = true;

	ds.mPanId                                = THREAD_PANID;
	ds.mComponents.mIsPanIdPresent           = true;

	memcpy(ds.mNetworkKey.m8, k_network_key, OT_NETWORK_KEY_SIZE);
	ds.mComponents.mIsNetworkKeyPresent      = true;

	memcpy(ds.mExtendedPanId.m8, k_ext_pan_id, OT_EXT_PAN_ID_SIZE);
	ds.mComponents.mIsExtendedPanIdPresent   = true;

	size_t name_len = strlen(THREAD_NETWORK_NAME);
	memcpy(ds.mNetworkName.m8, THREAD_NETWORK_NAME, name_len + 1);
	ds.mComponents.mIsNetworkNamePresent     = true;

	/*
	 * Always set the mesh-local prefix to match the OTBR's network.
	 *
	 * The OTBR reconstructs our RLOC source address from IPHC SAM=11 using
	 * its own mesh-local prefix (context 0).  The UDP checksum pseudo-header
	 * on the device uses the same RLOC.  If the two prefixes differ — which
	 * happens on any cold start where OpenThread generates a random prefix —
	 * the receiver computes a different checksum and drops the packet with
	 * "Bad UDP checksum".  Hardcoding it here is consistent with the rest of
	 * our credential set and avoids relying on NVS being populated.
	 */
	memcpy(ds.mMeshLocalPrefix.m8, k_mesh_local_prefix, OT_IP6_PREFIX_SIZE);
	ds.mComponents.mIsMeshLocalPrefixPresent = true;

	otError ot_err = otDatasetSetActive(instance, &ds);
	if (ot_err != OT_ERROR_NONE) {
		LOG_ERR("otDatasetSetActive failed: %d", ot_err);
		return -EIO;
	}

	return 0;
}

/* ── Start OT CoAP — called once at init ─────────────────────────── */
static int start_ot_coap(otInstance *ot)
{
	if (s_coap_started) {
		return 0;
	}

	/*
	 * otCoapStart binds the CoAP socket to OT_NETIF_THREAD internally.
	 * This ensures outgoing packets use the Thread ML-EID as source,
	 * so the UDP checksum pseudo-header and 6LoWPAN IPHC encoding are
	 * computed over the same address within the same OT call stack.
	 */
	otError err = otCoapStart(ot, COAP_PORT);
	if (err != OT_ERROR_NONE) {
		LOG_ERR("otCoapStart failed: %d", err);
		return -EIO;
	}

	s_coap_started = true;
	return 0;
}

/* ── Per-packet CoAP send helper ─────────────────────────────────────
 *
 * Prepends burst_header_t to `body`, wraps in a CoAP NON POST, and
 * queues via OpenThread's native CoAP API.
 *
 * Caller MUST hold the OT API mutex.
 * otCoapSendRequest takes ownership of the otMessage regardless of outcome.
 */
static int send_ot_coap(otInstance *ot,
			uint8_t pkt_type, uint16_t seq, uint16_t count,
			uint32_t timestamp_ms,
			const uint8_t *body, uint16_t body_len,
			const otIp6Address *dst)
{
	/* Build flat payload: burst_header + type-specific body */
	uint8_t  payload[BODY_BUF_MAX];
	uint16_t plen = 0;

	burst_header_t hdr = {
		.type         = pkt_type,
		.reserved     = 0,
		.seq          = seq,
		.sample_count = count,
		.timestamp_ms = timestamp_ms,
	};
	memcpy(payload + plen, &hdr,  sizeof(hdr));  plen += sizeof(hdr);
	memcpy(payload + plen, body, body_len);       plen += body_len;

	/* Allocate an OT CoAP message */
	otMessage *msg = otCoapNewMessage(ot, NULL);
	if (!msg) {
		LOG_ERR("no OT message buffers (0x%02x)", pkt_type);
		return -ENOMEM;
	}

	otCoapMessageInit(msg, OT_COAP_TYPE_NON_CONFIRMABLE, OT_COAP_CODE_POST);

	otError ot_err = otCoapMessageAppendUriPathOptions(msg, COAP_RESOURCE);
	if (ot_err != OT_ERROR_NONE) {
		LOG_ERR("CoAP URI option 0x%02x: %d", pkt_type, ot_err);
		otMessageFree(msg);
		return -EIO;
	}

	ot_err = otCoapMessageSetPayloadMarker(msg);
	if (ot_err != OT_ERROR_NONE) {
		otMessageFree(msg);
		return -EIO;
	}

	ot_err = otMessageAppend(msg, payload, plen);
	if (ot_err != OT_ERROR_NONE) {
		LOG_ERR("otMessageAppend 0x%02x: %d", pkt_type, ot_err);
		otMessageFree(msg);
		return -EIO;
	}

	otMessageInfo info;
	memset(&info, 0, sizeof(info));
	memcpy(&info.mPeerAddr, dst, sizeof(*dst));
	info.mPeerPort = COAP_PORT;

	/* otCoapSendRequest takes ownership of msg regardless of outcome */
	ot_err = otCoapSendRequest(ot, msg, &info, NULL, NULL);
	if (ot_err != OT_ERROR_NONE) {
		LOG_ERR("otCoapSendRequest 0x%02x: %d", pkt_type, ot_err);
		return -EIO;
	}

	LOG_DBG("TX 0x%02x seq=%u ts=%ums payload=%u", pkt_type, seq, timestamp_ms, plen);
	return 0;
}

/* ── Public API ──────────────────────────────────────────────────── */

int thread_init(event_post_fn cb)
{
	s_evt_post     = cb;
	s_connected    = false;
	s_coap_started = false;

	/*
	 * Register our role-change callback WITHOUT replacing Zephyr's internal
	 * ot_state_changed_handler (registered in openthread.c:366).  That
	 * handler manages net_if dormant state and adds IPv6 addresses to the
	 * Zephyr net stack; calling otSetStateChangedCallback() directly would
	 * silently overwrite it and break those paths.
	 */
	s_state_cb.otCallback = ot_state_changed;
	s_state_cb.user_data  = NULL;
	openthread_state_changed_callback_register(&s_state_cb);

	otInstance *ot_instance = openthread_get_default_instance();

	openthread_mutex_lock();

	int err = configure_dataset(ot_instance);
	if (err) {
		openthread_mutex_unlock();
		return err;
	}

	err = start_ot_coap(ot_instance);
	if (err) {
		openthread_mutex_unlock();
		return err;
	}

	otIp6SetEnabled(ot_instance, true);
	otThreadSetEnabled(ot_instance, true);

	openthread_mutex_unlock();

	LOG_INF("Thread stack started — ch=%d PAN=0x%04X net=\"%s\"",
		THREAD_CHANNEL, THREAD_PANID, THREAD_NETWORK_NAME);
	return 0;
}

bool thread_is_connected(void)
{
	return s_connected;
}

int thread_publish_burst(uint16_t seq, uint16_t count, uint32_t timestamp_ms,
			 const time_stats_t  *ts,
			 const fft_stats_t   *fs,
			 const env_reading_t *env)
{
	otInstance   *ot = openthread_get_default_instance();
	otIp6Address  leader_rloc;
	int           err  = 0;
	int           pkts = 0;

	/* ── Diagnostics + leader RLOC — one mutex window ────────────── */
	openthread_mutex_lock();

	const otMeshLocalPrefix *mlp = otThreadGetMeshLocalPrefix(ot);

	if (mlp) {
		LOG_INF("Mesh-local prefix: %02x%02x:%02x%02x:%02x%02x:%02x%02x::/64",
			mlp->m8[0], mlp->m8[1], mlp->m8[2], mlp->m8[3],
			mlp->m8[4], mlp->m8[5], mlp->m8[6], mlp->m8[7]);
	}

	for (const otNetifAddress *a = otIp6GetUnicastAddresses(ot);
	     a != NULL; a = a->mNext) {
		const uint8_t *b = a->mAddress.mFields.m8;

		LOG_INF("OT addr[%s]: %02x%02x:%02x%02x:%02x%02x:%02x%02x:"
			"%02x%02x:%02x%02x:%02x%02x:%02x%02x",
			a->mRloc ? "RLOC" : "    ",
			b[0], b[1], b[2], b[3], b[4], b[5], b[6], b[7],
			b[8], b[9], b[10], b[11], b[12], b[13], b[14], b[15]);
	}

	otError ot_err = otThreadGetLeaderRloc(ot, &leader_rloc);
	openthread_mutex_unlock();

	if (ot_err != OT_ERROR_NONE) {
		LOG_ERR("otThreadGetLeaderRloc: %d", ot_err);
		return -ENETDOWN;
	}

	/* ── Packet 1: time-domain feature vector ─────────────────── */
	/*    burst_header(10) + time_stats(36) = 46 B → 61 B CoAP    */
	openthread_mutex_lock();
	err = send_ot_coap(ot, PKT_TYPE_TIME_STATS, seq, count, timestamp_ms,
			   (const uint8_t *)ts, sizeof(*ts), &leader_rloc);
	openthread_mutex_unlock();
	if (!err) {
		pkts++;
	}

	/* ── Packet 2: frequency-domain feature vector ────────────── */
	/*    burst_header(10) + fft_stats(60) = 70 B → 85 B CoAP     */
	if (!err) {
		openthread_mutex_lock();
		err = send_ot_coap(ot, PKT_TYPE_FFT_STATS, seq, count, timestamp_ms,
				   (const uint8_t *)fs, sizeof(*fs), &leader_rloc);
		openthread_mutex_unlock();
		if (!err) {
			pkts++;
		}
	}

	/* ── Packet 3: environmental reading (when sensor present) ── */
	/*    burst_header(10) + env(8) = 18 B → 33 B CoAP            */
	if (!err && env && env->valid) {
		uint8_t env_buf[sizeof(env->temperature) +
				sizeof(env->humidity)    +
				sizeof(env->pressure)];
		uint16_t elen = 0;

		memcpy(env_buf + elen, &env->temperature, sizeof(env->temperature));
		elen += sizeof(env->temperature);
		memcpy(env_buf + elen, &env->humidity,    sizeof(env->humidity));
		elen += sizeof(env->humidity);
		memcpy(env_buf + elen, &env->pressure,    sizeof(env->pressure));
		elen += sizeof(env->pressure);

		openthread_mutex_lock();
		err = send_ot_coap(ot, PKT_TYPE_ENV, seq, count, timestamp_ms,
				   env_buf, elen, &leader_rloc);
		openthread_mutex_unlock();
		if (!err) {
			pkts++;
		}
	}

	if (!err) {
		LOG_INF("Thread TX: seq=%u ts=%ums → %d packets → leader RLOC",
			seq, timestamp_ms, pkts);
	}
	return err;
}
